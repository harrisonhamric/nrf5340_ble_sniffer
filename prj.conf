## CMakeLists.txt
```
#
# Copyright (c) 2018 Nordic Semiconductor
#
# SPDX-License-Identifier: LicenseRef-Nordic-5-Clause
#
cmake_minimum_required(VERSION 3.20.0)

set(PM_STATIC_YML_FILE
  ${CMAKE_CURRENT_SOURCE_DIR}/boards/pm_static_${BOARD}.yml
  )

find_package(Zephyr REQUIRED HINTS $ENV{ZEPHYR_BASE})
project(NONE)

# NORDIC SDK APP START
target_sources(app PRIVATE
  src/main.cpp
  src/Sniffer.cpp
  src/helpers/HelperFunctions.cpp
  src/leds/LedController.cpp
  src/buttons/Buttons.cpp
  src/ble/bleCentral.cpp
)

target_include_directories(app PRIVATE
  src
  src/ble
  src/buttons
  src/helpers
  src/leds
)

# Preinitialization related to Thingy:53 DFU
target_sources_ifdef(CONFIG_BOARD_THINGY53_NRF5340_CPUAPP app PRIVATE
  boards/thingy53.c
)

# NORDIC SDK APP END
zephyr_library_include_directories(.)
```

## sample.yaml
```
sample:
  name: BLE LED Button service
  description: Bluetooth Low Energy LED Button service sample
tests:
  samples.bluetooth.peripheral_lbs:
    build_only: true
    integration_platforms:
      - nrf51dk_nrf51422
      - nrf52dk_nrf52832
      - nrf52840dk_nrf52840
      - nrf5340dk_nrf5340_cpuapp
      - nrf5340dk_nrf5340_cpuapp_ns
      - thingy53_nrf5340_cpuapp
    tags: bluetooth ci_build
    platform_allow: nrf51dk_nrf51422 nrf52dk_nrf52832 nrf52840dk_nrf52840 nrf52dk_nrf52810
      nrf5340dk_nrf5340_cpuapp nrf5340dk_nrf5340_cpuapp_ns thingy53_nrf5340_cpuapp
    platform_exclude: thingy53_nrf5340_cpuapp_ns
  samples.bluetooth.peripheral_lbs_minimal:
    extra_args: OVERLAY_CONFIG=prj_minimal.conf
    build_only: true
    platform_allow: nrf51dk_nrf51422 nrf52dk_nrf52810 nrf52840dk_nrf52811 nrf52833dk_nrf52820
    integration_platforms:
      - nrf51dk_nrf51422
      - nrf52dk_nrf52810
      - nrf52840dk_nrf52811
      - nrf52833dk_nrf52820
    tags: bluetooth ci_build
```

## west.yml
```
manifest:
  remotes:
    - name: ncs
      url-base: https://github.com/nrfconnect
  projects:
    - name: sdk-nrf
      remote: ncs
      path: nrf
      revision: v1.7.1
      import: true
      clone-depth: 1
  self:
    path: start
```

## prj.conf
```kconfig
#
# Copyright (c) 2018 Nordic Semiconductor
#
# SPDX-License-Identifier: LicenseRef-Nordic-5-Clause
#
CONFIG_NCS_SAMPLES_DEFAULTS=y

CONFIG_NEWLIB_LIBC=y

CONFIG_BT=y
CONFIG_BT_PERIPHERAL=y
CONFIG_BT_DEVICE_NAME="Nordic_LBS"

# Enable the LBS service
CONFIG_BT_LBS=y
CONFIG_BT_LBS_POLL_BUTTON=y
CONFIG_DK_LIBRARY=y

CONFIG_SYSTEM_WORKQUEUE_STACK_SIZE=2048
```

## prj_minimal.conf
```kconfig
# BEGIN Configurations from basic/minimal

CONFIG_NCS_SAMPLES_DEFAULTS=y

CONFIG_BT=y
CONFIG_BT_PERIPHERAL=y
CONFIG_BT_DEVICE_NAME="Nordic_LBS"

# Enable the LBS service
CONFIG_BT_LBS=y
CONFIG_BT_LBS_POLL_BUTTON=y
CONFIG_DK_LIBRARY=y

# Drivers and peripherals
CONFIG_I2C=n
CONFIG_WATCHDOG=n
CONFIG_GPIO=n
CONFIG_PINMUX=n
CONFIG_SPI=n
CONFIG_SERIAL=n

# Power management
CONFIG_PM=n

# Interrupts
CONFIG_DYNAMIC_INTERRUPTS=n
CONFIG_IRQ_OFFLOAD=n

# Memory protection
CONFIG_THREAD_STACK_INFO=n
CONFIG_THREAD_CUSTOM_DATA=n
CONFIG_FPU=n

# Boot
CONFIG_BOOT_BANNER=n
CONFIG_BOOT_DELAY=0

# Console
CONFIG_CONSOLE=n
CONFIG_UART_CONSOLE=n
CONFIG_STDOUT_CONSOLE=n
CONFIG_PRINTK=n
CONFIG_EARLY_CONSOLE=n

# Build
CONFIG_SIZE_OPTIMIZATIONS=y

# ARM
CONFIG_ARM_MPU=n
# END Configurations from basic/minimal

# In order to correctly tune the stack sizes for the threads the following
# Configurations can enabled to print the current use:
# CONFIG_THREAD_NAME=y
# CONFIG_THREAD_ANALYZER=y
# CONFIG_THREAD_ANALYZER_AUTO=y
# CONFIG_THREAD_ANALYZER_RUN_UNLOCKED=y
# CONFIG_THREAD_ANALYZER_USE_PRINTK=y
# CONFIG_CONSOLE=y
# CONFIG_UART_CONSOLE=y
# CONFIG_SERIAL=y
# CONFIG_PRINTK=y

# Example output of thread analyzer
# SDC RX              : unused 816 usage 208 / 1024 (20 %)
# BT RX               : unused 1784 usage 416 / 2200 (18 %)
# BT TX               : unused 992 usage 544 / 1536 (35 %)
# thread_analyzer     : unused 136 usage 376 / 512 (73 %)
# sysworkq            : unused 1824 usage 224 / 2048 (10 %)
# MPSL signal         : unused 520 usage 504 / 1024 (49 %)
# idle 00             : unused 192 usage 64 / 256 (25 %)
# main                : unused 136 usage 888 / 1024 (86 %)
# Configurations set based on thread analyzer output.
CONFIG_SDC_RX_STACK_SIZE=324
CONFIG_BT_RX_STACK_SIZE=1024
CONFIG_BT_HCI_TX_STACK_SIZE_WITH_PROMPT=y
CONFIG_BT_HCI_TX_STACK_SIZE=640
CONFIG_SYSTEM_WORKQUEUE_STACK_SIZE=256
CONFIG_MPSL_SIGNAL_STACK_SIZE=640
CONFIG_MAIN_STACK_SIZE=1024
CONFIG_IDLE_STACK_SIZE=128
CONFIG_ISR_STACK_SIZE=1024

# Disable features not needed
CONFIG_TIMESLICING=n
CONFIG_MINIMAL_LIBC_MALLOC=n
CONFIG_LOG=n
CONFIG_ASSERT=n

# Disable Bluetooth features not needed
CONFIG_BT_DEBUG_NONE=y
CONFIG_BT_ASSERT=n
CONFIG_BT_DATA_LEN_UPDATE=n
CONFIG_BT_PHY_UPDATE=n
CONFIG_BT_GATT_CACHING=n
CONFIG_BT_GATT_SERVICE_CHANGED=n
CONFIG_BT_GAP_PERIPHERAL_PREF_PARAMS=n
CONFIG_BT_SETTINGS_CCC_LAZY_LOADING=y
CONFIG_BT_HCI_VS_EXT=n

# Disable Bluetooth controller features not needed
CONFIG_BT_CTLR_PRIVACY=n
CONFIG_BT_CTLR_PHY_2M=n

# Reduce Bluetooth buffers
CONFIG_BT_BUF_EVT_DISCARDABLE_COUNT=1
CONFIG_BT_BUF_EVT_DISCARDABLE_SIZE=43
CONFIG_BT_BUF_EVT_RX_COUNT=2

CONFIG_BT_CONN_TX_MAX=2
CONFIG_BT_L2CAP_TX_BUF_COUNT=2
CONFIG_BT_CTLR_RX_BUFFERS=1
CONFIG_BT_BUF_ACL_TX_COUNT=3
CONFIG_BT_BUF_ACL_TX_SIZE=27
```

## src/main.c
```c
/*
 * Copyright (c) 2018 Nordic Semiconductor ASA
 *
 * SPDX-License-Identifier: LicenseRef-Nordic-5-Clause
 */

#include <zephyr/types.h>
#include <stddef.h>
#include <string.h>
#include <errno.h>
#include <sys/printk.h>
#include <sys/byteorder.h>
#include <zephyr.h>
#include <drivers/gpio.h>
#include <soc.h>

#include <bluetooth/bluetooth.h>
#include <bluetooth/hci.h>
#include <bluetooth/conn.h>
#include <bluetooth/uuid.h>
#include <bluetooth/gatt.h>

#include <bluetooth/services/lbs.h>

#include <settings/settings.h>

#include <dk_buttons_and_leds.h>

#define DEVICE_NAME             CONFIG_BT_DEVICE_NAME
#define DEVICE_NAME_LEN         (sizeof(DEVICE_NAME) - 1)


#define RUN_STATUS_LED          DK_LED1
#define CON_STATUS_LED          DK_LED2
#define RUN_LED_BLINK_INTERVAL  1000

#define USER_LED                DK_LED3

#define USER_BUTTON             DK_BTN1_MSK

static bool app_button_state;

static const struct bt_data ad[] = {
	BT_DATA_BYTES(BT_DATA_FLAGS, (BT_LE_AD_GENERAL | BT_LE_AD_NO_BREDR)),
	BT_DATA(BT_DATA_NAME_COMPLETE, DEVICE_NAME, DEVICE_NAME_LEN),
};

static const struct bt_data sd[] = {
	BT_DATA_BYTES(BT_DATA_UUID128_ALL, BT_UUID_LBS_VAL),
};

static void connected(struct bt_conn *conn, uint8_t err)
{
	if (err) {
		printk("Connection failed (err %u)\n", err);
		return;
	}

	printk("Connected\n");

	dk_set_led_on(CON_STATUS_LED);
}

static void disconnected(struct bt_conn *conn, uint8_t reason)
{
	printk("Disconnected (reason %u)\n", reason);

	dk_set_led_off(CON_STATUS_LED);
}

#ifdef CONFIG_BT_LBS_SECURITY_ENABLED
static void security_changed(struct bt_conn *conn, bt_security_t level,
			     enum bt_security_err err)
{
	char addr[BT_ADDR_LE_STR_LEN];

	bt_addr_le_to_str(bt_conn_get_dst(conn), addr, sizeof(addr));

	if (!err) {
		printk("Security changed: %s level %u\n", addr, level);
	} else {
		printk("Security failed: %s level %u err %d\n", addr, level,
			err);
	}
}
#endif

static struct bt_conn_cb conn_callbacks = {
	.connected        = connected,
	.disconnected     = disconnected,
#ifdef CONFIG_BT_LBS_SECURITY_ENABLED
	.security_changed = security_changed,
#endif
};

#if defined(CONFIG_BT_LBS_SECURITY_ENABLED)
static void auth_passkey_display(struct bt_conn *conn, unsigned int passkey)
{
	char addr[BT_ADDR_LE_STR_LEN];

	bt_addr_le_to_str(bt_conn_get_dst(conn), addr, sizeof(addr));

	printk("Passkey for %s: %06u\n", addr, passkey);
}

static void auth_cancel(struct bt_conn *conn)
{
	char addr[BT_ADDR_LE_STR_LEN];

	bt_addr_le_to_str(bt_conn_get_dst(conn), addr, sizeof(addr));

	printk("Pairing cancelled: %s\n", addr);
}

static void pairing_confirm(struct bt_conn *conn)
{
	char addr[BT_ADDR_LE_STR_LEN];

	bt_addr_le_to_str(bt_conn_get_dst(conn), addr, sizeof(addr));

	bt_conn_auth_pairing_confirm(conn);

	printk("Pairing confirmed: %s\n", addr);
}

static void pairing_complete(struct bt_conn *conn, bool bonded)
{
	char addr[BT_ADDR_LE_STR_LEN];

	bt_addr_le_to_str(bt_conn_get_dst(conn), addr, sizeof(addr));

	printk("Pairing completed: %s, bonded: %d\n", addr, bonded);
}

static void pairing_failed(struct bt_conn *conn, enum bt_security_err reason)
{
	char addr[BT_ADDR_LE_STR_LEN];

	bt_addr_le_to_str(bt_conn_get_dst(conn), addr, sizeof(addr));

	printk("Pairing failed conn: %s, reason %d\n", addr, reason);
}

static struct bt_conn_auth_cb conn_auth_callbacks = {
	.passkey_display = auth_passkey_display,
	.cancel = auth_cancel,
	.pairing_confirm = pairing_confirm,
	.pairing_complete = pairing_complete,
	.pairing_failed = pairing_failed
};
#else
static struct bt_conn_auth_cb conn_auth_callbacks;
#endif

static void app_led_cb(bool led_state)
{
	dk_set_led(USER_LED, led_state);
}

static bool app_button_cb(void)
{
	return app_button_state;
}

static struct bt_lbs_cb lbs_callbacs = {
	.led_cb    = app_led_cb,
	.button_cb = app_button_cb,
};

static void button_changed(uint32_t button_state, uint32_t has_changed)
{
	if (has_changed & USER_BUTTON) {
		uint32_t user_button_state = button_state & USER_BUTTON;

		bt_lbs_send_button_state(user_button_state);
		app_button_state = user_button_state ? true : false;
	}
}

static int init_button(void)
{
	int err;

	err = dk_buttons_init(button_changed);
	if (err) {
		printk("Cannot init buttons (err: %d)\n", err);
	}

	return err;
}

void mainCFunc()
{
	int blink_status = 0;
	int err;

	printk("Starting Bluetooth Peripheral LBS example\n");

	err = dk_leds_init();
	if (err) {
		printk("LEDs init failed (err %d)\n", err);
		return;
	}

	err = init_button();
	if (err) {
		printk("Button init failed (err %d)\n", err);
		return;
	}

	bt_conn_cb_register(&conn_callbacks);
	if (IS_ENABLED(CONFIG_BT_LBS_SECURITY_ENABLED)) {
		bt_conn_auth_cb_register(&conn_auth_callbacks);
	}

	err = bt_enable(NULL);
	if (err) {
		printk("Bluetooth init failed (err %d)\n", err);
		return;
	}

	printk("Bluetooth initialized\n");

	if (IS_ENABLED(CONFIG_SETTINGS)) {
		settings_load();
	}

	err = bt_lbs_init(&lbs_callbacs);
	if (err) {
		printk("Failed to init LBS (err:%d)\n", err);
		return;
	}

	err = bt_le_adv_start(BT_LE_ADV_CONN, ad, ARRAY_SIZE(ad),
			      sd, ARRAY_SIZE(sd));
	if (err) {
		printk("Advertising failed to start (err %d)\n", err);
		return;
	}

	printk("Advertising successfully started\n");

	for (;;) {
		dk_set_led(RUN_STATUS_LED, (++blink_status) % 2);
		k_sleep(K_MSEC(RUN_LED_BLINK_INTERVAL));
	}
}
```

## src/main.cpp
```c
#include <zephyr.h>

#include <sys/printk.h>
#include <stdint.h>
#include <dk_buttons_and_leds.h>

#include "ReturnCode.h"
#include "HelperFunctions.h"
#include "LedController.h"
#include "Buttons.h"
#include "Sniffer.h"
#include "bleCentral.h"

#define SLEEP_TIME 500

int main()
{   
    Sniffer daSniff = Sniffer();
    daSniff.Run();
    LedController localLEDS = daSniff.GetLeds();
    bleCentral localBle = daSniff.GetBle();
    uint8_t sleepTimeFromSigStrength; // = 3000
    for (;;) {
        sleepTimeFromSigStrength = localBle.GetSleepTimeFromSigStrength();
        localLEDS.SetAllLedsOn();
		k_sleep(K_MSEC(sleepTimeFromSigStrength));
        localLEDS.SetAllLedsOff();
        k_sleep(K_MSEC(sleepTimeFromSigStrength));
	}
    return 0;
}
```

## src/ButtonState.h
```c
#include <stdint.h>
#include <dk_buttons_and_leds.h>

enum class ButtonState : uint32_t
{
    Default = 0,
    Button1 = DK_BTN1_MSK,
    Button2 = DK_BTN2_MSK,
    Button3 = DK_BTN3_MSK,
    Button4 = DK_BTN4_MSK,
    AllButtons = DK_ALL_BTNS_MSK
};
```

## src/Buttons.cpp
```c
#include "Buttons.h"

Buttons::Buttons(): _buttonState(ButtonState::Default)
{

}

void Buttons::Init(button_handler_t buttonHandler)
{
    ReturnCode rc = (ReturnCode) dk_buttons_init(buttonHandler);
    CHECK_RETURN_CODE(rc);
}

ButtonState Buttons::GetButtonState()
{
    return (ButtonState)dk_get_buttons();
}
```

## src/Buttons.h
```c
#pragma once

#include <stdint.h>

#include "ReturnCode.h"
#include "HelperFunctions.h"
#include "ButtonState.h"

class Buttons 
{
public: 
    Buttons();
    void Init(button_handler_t buttonHandler);
    ButtonState GetButtonState();
private:
    ButtonState _buttonState;
};
```

## src/HelperFunctions.cpp
```c
#include "HelperFunctions.h"

void CHECK_RETURN_CODE(ReturnCode rc)
{
    switch (rc)
    {
    case ReturnCode::Success:
        break;
    case ReturnCode::Failure:
        printf("FAILURE RETURN CODE");
        break;
    default:
        printf("FAILURE RETURN CODE");
        break;
    }
}
```

## src/HelperFunctions.h
```c
#pragma once

#include <stdint.h>
#include "ReturnCode.h"
#include <stdio.h>


void CHECK_RETURN_CODE(ReturnCode rc);
```

## src/LedController.cpp
```c
#include "LedController.h"

LedController::LedController(): _blink_status(0)
{

}

void LedController::Init()
{
    ReturnCode rc = (ReturnCode)dk_leds_init();
    CHECK_RETURN_CODE(rc);
}

void LedController::SwitchAllLeds()
{
    dk_set_leds(DK_ALL_LEDS_MSK);
}

void LedController::SetAllLedsOn()
{
    for(uint8_t i=0; i < 4; i++)
    {
        dk_set_led_on(i);
    }
}

void LedController::SetAllLedsOff()
{
    for(uint8_t i=0; i < 4; i++)
    {
        dk_set_led_off(i);
    }
}

void LedController::SetLED(uint8_t LED)
{
    ReturnCode rc;
    for(uint8_t i=0; i < 4; i++)
    {
        if(i == LED)
        {
            rc = (ReturnCode) dk_set_led_on(LED);
        }
        else
        {
            rc = (ReturnCode) dk_set_led_off(i);
        }
    }
}

// void LedController::InitLED(uint8_t LED)
// {
//     ReturnCode rc = dk_set_led_on(LED3);
//     CHECK_RETURN_CODE(rc);
// }
```

## src/LedController.h
```c
#pragma once

#include <dk_buttons_and_leds.h>
#include "ReturnCode.h"
#include "HelperFunctions.h"

#define LED1 DK_LED1
#define LED2 DK_LED2
#define LED3 DK_LED3
#define LED4 DK_LED4
#define LEDNONE 5

#define RUN_LED_BLINK_INTERVAL 2000

class LedController
{
public:
    LedController();
    void Init();
    static void SetLED(uint8_t LED);
    void SetAllLedsOn();
    void SwitchAllLeds();
    void SetAllLedsOff();
private:
    uint32_t _blink_status;
};
```

## src/ReturnCode.h
```c
#pragma once
#include <stdint.h>

enum class ReturnCode : int8_t
{
    Success = 0,
    Failure = -1 
};
```

## src/Sniffer.cpp
```c
#include "Sniffer.h"


// static void LEDButtonHandler(uint32_t button_state, uint32_t has_changed)
// {
//     ButtonState bs = (ButtonState) button_state;
//     switch(bs)
//     {
//     case ButtonState::Button1:
//         LedController::SetLED(LED1);
//         break;
//     case ButtonState::Button2:
//         LedController::SetLED(LED2);
//         break;
//     case ButtonState::Button3:
//         LedController::SetLED(LED3);
//         break;
//     case ButtonState::Button4:
//         LedController::SetLED(LED4);
//         break;
//     default:
//         LedController::SetLED(LEDNONE);
//         break;
//     }
// }

Sniffer::Sniffer(): 
                _LEDS(),
                _buttons(),
                _ble()
{

}

void Sniffer::Run()
{
    _LEDS.Init();
    _ble.InitBleScanner();
    // _buttons.Init((button_handler_t)LEDButtonHandler());
    // dk_buttons_init(LEDButtonHandler);
}

LedController Sniffer::GetLeds()
{
    return _LEDS;
}

bleCentral Sniffer::GetBle()
{
    return _ble;
}
```

## src/Sniffer.h
```c
#pragma once

#include <sys/printk.h>
#include <stdint.h>
#include <dk_buttons_and_leds.h>

#include "ReturnCode.h"
#include "HelperFunctions.h"
#include "LedController.h"
#include "Buttons.h"
#include "Sniffer.h"
#include "bleCentral.h"

class Sniffer 
{
public:
    Sniffer();
    void Run(void);
    LedController GetLeds();
    bleCentral GetBle();
private:
    LedController _LEDS;
    Buttons _buttons;
    bleCentral _ble;
};
```
